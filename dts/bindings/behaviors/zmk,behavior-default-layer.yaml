## dts/bindings/behaviors/zmk,behavior-default-layer.yaml
```yaml
# Copyright (c) 2024 The ZMK Contributors
# SPDX-License-Identifier: MIT

description: Behavior to change default layer for current endpoint

compatible: "zmk,behavior-default-layer"

include: two_param.yaml
```
